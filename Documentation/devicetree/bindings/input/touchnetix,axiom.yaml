## Documentation/devicetree/bindings/input/touchnetix,axiom.yaml
```yaml
# SPDX-License-Identifier: (GPL-2.0-only OR BSD-2-Clause)
%YAML 1.2
---
$id: http://devicetree.org/schemas/input/touchnetix,axiom.yaml#
$schema: http://devicetree.org/meta-schemas/core.yaml#

title: TouchNetix Axiom series touchscreen controller

maintainers:
  - Kamel Bouhara <kamel.bouhara@bootlin.com>

allOf:
  - $ref: /schemas/input/touchscreen/touchscreen.yaml#

properties:
  compatible:
    const: touchnetix,axiom

  reg:
    const: 0x66

  interrupts:
    maxItems: 1

  irq-gpios:
    maxItems: 1
    description: IRQ GPIO.

  reset-gpios:
    maxItems: 1
    description: Reset GPIO.

required:
  - compatible
  - reg
  - interrupts

additionalProperties: false

examples:
  - |
    i2c {
      #address-cells = <1>;
      #size-cells = <0>;
      axiom@66 {
        compatible = "touchnetix,axiom";
        reg = <0x66>;
        interrupt-parent = <&gpio>;
        interrupts = <0 0>;
        irq-gpios = <&gpio1 0 0>;
        reset-gpios = <&gpio 60 GPIO_ACTIVE_LOW>;
      };
    };
```
